## yocto/meta-myboard/conf/layer.conf
```bitbake
# meta-myboard layer configuration
BBPATH .= ":${LAYERDIR}"
BBFILES += "${LAYERDIR}/recipes-*/*/*.bbappend"

BBFILE_COLLECTIONS += "myboard"
BBFILE_PATTERN_myboard = "^${LAYERDIR}/"
BBFILE_PRIORITY_myboard = "99"

LAYERSERIES_COMPAT_myboard = "scarthgap kirkstone nanbield"
```
